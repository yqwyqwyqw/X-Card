#include <Arduino.h>
#include <U8g2lib.h>
#include <ESP8266WiFi.h>
#include <DS3231.h>
#include <SPI.h>
#include <Wire.h>
#include <WiFiUdp.h>
#include <NTPClient.h>
/*    OLED   */		
U8G2_SSD1306_128X64_NONAME_F_SW_I2C u8g2(U8G2_R0, /* clock=*/ D4, /* data=*/ D3, /* reset=*/ U8X8_PIN_NONE);   // All Boards without Reset of the Display
/*    DS3231     */
DateTime dt(2020, 03, 13, 01, 01, 0, 5);
DS3231 RTC;
/*     WIFI      */
wl_status_t wifi_handle;
/*		时间NTP		*/
const char Days[12] = { 31, 28, 31, 30, 31, 30, 31, 31, 30, 31, 30, 31 };
WiFiUDP ntpUDP;
NTPClient timeClient(ntpUDP, "ntp1.aliyun.com", 60 * 60 * 8, 30 * 60 * 1000);

//static const unsigned char PROGMEM robofuture[] = {
//  0x00, 0x00, 0x00, 0x00, 0x00, 0x00, 0x00, 0x00, 0x00, 0x00, 0x00, 0x00,
//  0x00, 0x00, 0x00, 0x00, 0x00, 0x00, 0x00, 0x0C, 0x00, 0x00, 0x00, 0x00,
//  0x00, 0x00, 0xFE, 0x01, 0x00, 0x07, 0x00, 0x00, 0x3F, 0x00, 0x00, 0x00,
//  0x00, 0x00, 0x00, 0xFE, 0x07, 0x00, 0x07, 0x00, 0x80, 0x7F, 0x00, 0x00,
//  0x00, 0x00, 0x00, 0x00, 0xFE, 0x07, 0x00, 0x07, 0x00, 0x80, 0x1F, 0x00,
//  0x00, 0x00, 0x00, 0x00, 0x00, 0x9E, 0x87, 0x0F, 0x77, 0xE0, 0xC3, 0x03,
//  0xE7, 0x70, 0xCE, 0xE1, 0xF8, 0x00, 0x9E, 0xC7, 0x1F, 0xF7, 0xF0, 0xC7,
//  0x03, 0xE7, 0x78, 0xEE, 0xF1, 0xFC, 0x03, 0xDE, 0xE7, 0x3F, 0xF7, 0xF9,
//  0xCF, 0x03, 0xF7, 0x78, 0xEF, 0xF9, 0xFE, 0x03, 0xDE, 0xF3, 0x3D, 0xF7,
//  0x79, 0xCF, 0x07, 0xE7, 0x7C, 0xEF, 0xF9, 0x9E, 0x07, 0xDE, 0xF3, 0x38,
//  0xC7, 0x39, 0xDE, 0x07, 0xF7, 0x3C, 0xEF, 0x79, 0xEE, 0x07, 0xDE, 0xF3,
//  0x38, 0xC7, 0x39, 0xDE, 0x07, 0xE7, 0x3C, 0xEF, 0x79, 0x1E, 0x00, 0xDE,
//  0xE7, 0x3F, 0xFF, 0xF9, 0xCF, 0x03, 0xFF, 0x3C, 0xFE, 0x79, 0x1E, 0x00,
//  0x9E, 0xE7, 0x1F, 0xFF, 0xF1, 0xCF, 0x03, 0xFF, 0x3C, 0xFE, 0x78, 0xFC,
//  0x00, 0x9E, 0xC7, 0x1F, 0xFE, 0xF0, 0xC7, 0x03, 0x7E, 0x3C, 0xFC, 0x78,
//  0xFC, 0x01, 0x1C, 0x07, 0x07, 0x38, 0xC0, 0x81, 0x03, 0x1C, 0x18, 0x38,
//  0x30, 0x70, 0x00, 0x00, 0x00, 0x00, 0x00, 0x00, 0x00, 0x00, 0x00, 0x00,
//  0x00, 0x00, 0x00, 0x00, };
static const unsigned char PROGMEM robofuture[] = {
  0x00, 0x00, 0x00, 0x00, 0x00, 0x00, 0x00, 0x00, 0x00, 0x00, 0x00, 0x00,
  0x00, 0x00, 0x00, 0x00, 0x00, 0x00, 0x00, 0x00, 0x00, 0x00, 0x00, 0x00,
  0x00, 0x00, 0x00, 0x00, 0x00, 0x00, 0x00, 0x00, 0x00, 0x00, 0x00, 0x00,
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  0x00, 0x00, 0x00, 0x00, 0x00, 0x00, 0x00, 0x00, 0x00, 0x00, };

static const unsigned char PROGMEM weixin[] = {
  0x00, 0x00, 0x00, 0x00, 0x00, 0x00, 0x00, 0x00, 0x00, 0x00, 0x00, 0x00,
  0x00, 0x00, 0x00, 0x00, 0xFC, 0x9F, 0x4F, 0x72, 0xC8, 0x07, 0xF9, 0x3F,
  0x0C, 0x98, 0xFF, 0xEF, 0xC0, 0xF8, 0x19, 0x30, 0x04, 0x90, 0xFF, 0xEF,
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  0x00, 0x00, 0x00, 0x00, 0x00, 0x00, 0x00, 0x00,
};

static const unsigned char PROGMEM tenxunqq[] = {
  0x00, 0x00, 0x00, 0x00, 0x00, 0x00, 0x00, 0x00, 0x00, 0x00, 0x00, 0x00,
  0x00, 0x00, 0x00, 0x00, 0xFC, 0x3F, 0x0C, 0x19, 0x0E, 0x7F, 0xFE, 0x3F,
  0x5C, 0x75, 0x85, 0xA7, 0x06, 0xFC, 0x5E, 0x35, 0x0C, 0x60, 0xC3, 0xE7,
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  0x00, 0x00, 0x00, 0x00, 0x00, 0x00, 0x00, 0x00,
};

void setup() {
  // put your setup code here, to run once:
  Serial.begin(115200);
  WiFi.disconnect();
  WiFi.mode(WIFI_STA);
  WiFi.begin("huawei", "qazwsxedc");
  //while (WiFi.status() != WL_CONNECTED);

  u8g2.begin();
  u8g2.setFont(u8g2_font_ncenB08_tr);
  u8g2.clearBuffer();

  u8g2.drawXBMP(64, 0, 64, 64, weixin);
  u8g2.sendBuffer();
  delay(10000);
  u8g2.clearBuffer();
  u8g2.drawXBMP(64, 0, 64, 64, tenxunqq);
  u8g2.sendBuffer();
  delay(10000);

  //RTC.adjust(dt);
  Wire.begin(D5,D6);
  RTC.begin();

}

DateTime time_update(unsigned long time) {
	unsigned int Pass4year;
	int hours_per_year;
	int year,month,day,hour,min,sec;
	if (time < 0)
	{
		time = 0;
	}
	//取秒时间
	sec = (int)(time % 60);
	time /= 60;
	//取分钟时间
	min = (int)(time % 60);
	time /= 60;
	//取过去多少个四年，每四年有 1461*24 小时
	Pass4year = ((unsigned int)time / (1461L * 24L));
	//计算年份
	year = (Pass4year << 2) + 1970;
	//四年中剩下的小时数
	time %= 1461L * 24L;
	//校正闰年影响的年份，计算一年中剩下的小时数
	for (;;)
	{
		//一年的小时数
		hours_per_year = 365 * 24;
		//判断闰年
		if ((year & 3) == 0)
		{
			//是闰年，一年则多24小时，即一天
			hours_per_year += 24;
		}
		if (time < hours_per_year)
		{
			break;
		}
		year++;
		time -= hours_per_year;
	}
	//小时数
	hour = (int)(time % 24);
	//一年中剩下的天数
	time /= 24;
	//假定为闰年
	time++;
	//校正闰年的误差，计算月份，日期
	if ((year & 3) == 0)
	{
		if (time > 60)
		{
			time--;
		}
		else
		{
			if (time == 60)
			{
				month = 1;
				day = 29;
				DateTime result(year, month, day, hour, min, sec, 1);
				return result;
			}
		}
	}
	//计算月日
	for (month = 0; Days[month] < time; month++)
	{
		time -= Days[month];
	}

	day = (int)(time);
	DateTime result(year, month, day, hour, min, sec, 1);
	return result;
}

void display_timeupdate(DateTime dtime) {
	//Serial.printf("%d-%d-%d", dtime.year(), dtime.month(), dtime.date());
	//Serial.printf("%d-%d-%d", dtime.hour(), dtime.minute(), dtime.second());
	u8g2.setCursor(10, 60);
	u8g2.printf("%d-%d-%d %d : %d : %d", dtime.year(), dtime.month(), dtime.date(), dtime.hour(), dtime.minute(), dtime.second());
}

void loop() {
  // put your main code here, to run repeatedly:
	wifi_handle = WiFi.status();
	u8g2.clearBuffer();
	DateTime now = RTC.now();
	if (wifi_handle == WL_CONNECTED ) {
		timeClient.begin();
		timeClient.update();
		now = time_update(timeClient.getEpochTime());
		RTC.adjust(now);
		//Serial.println(timeClient.getEpochTime());
		//Serial.println(timeClient.getDay());
		//Serial.println(timeClient.getFormattedTime());
	}
	u8g2.drawXBMP(14 ,15,100,34, robofuture);
	display_timeupdate(now);
	u8g2.sendBuffer();
	delay(1000);

}
